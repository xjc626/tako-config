## config/boards/shields/tako/Kconfig.defconfig
```kconfig
if SHIELD_TAKO_LEFT

config ZMK_KEYBOARD_NAME
  default "Tako"

config ZMK_SPLIT_ROLE_CENTRAL
  default y

endif

if SHIELD_TAKO_LEFT || SHIELD_TAKO_RIGHT

config ZMK_SPLIT
  default y

  if ZMK_DISPLAY
    
    config I2C
        default y
    
    config SSD1306
        default y
    
    endif

endif
```
